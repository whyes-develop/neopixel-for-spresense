## Kconfig
```kconfig
#
# For a description of the syntax of this configuration file,
# see the file kconfig-language.txt in the NuttX tools repository.
#

config EXTERNALS_NEOPIXEL
	bool "Adafruit Neopixel library"
	default n
	---help---
		Enable Adafruit Neopixel library.
```
